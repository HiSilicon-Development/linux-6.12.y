## Documentation/devicetree/bindings/clock/hisilicon,hi3798mv310-crg.yaml
```yaml
# SPDX-License-Identifier: (GPL-2.0-only OR BSD-2-Clause)
%YAML 1.2
---
$id: http://devicetree.org/schemas/clock/hisilicon,hi3798mv310-crg.yaml#
$schema: http://devicetree.org/meta-schemas/core.yaml#

title: HiSilicon Hi3798MV310 Clock and Reset Generator

maintainers:
  - Wei Xu <xuwei5@hisilicon.com>

description: |
  Peripheral gates, MMC source-rate selectors and phase taps, CPU APLL tuning,
  and active-high reset requests on Hi3798MV310. Clock identifiers are defined
  in dt-bindings/clock/hi3798mv310-clock.h. CPU frequency is capped at 1.2 GHz.
  The GPU clock supports the BSP's 200/300/400/500/600/675/750/800 MHz mux
  selections, including PP0/PP1 gates. The calibrated shared supply and OPP
  consumers own voltage sequencing; this clock provider does not run AVS.
  The eMMC source selector preserves the existing CRG0xa0 bit19 mode.

  MMC phase clocks describe the eight normal SDR taps (0 through 315 degrees
  in 45 degree steps), not DDR/HS400 half-cycle phase interpretation.
  Peripheral gates without a documented parent frequency do not imply a
  fixed clock rate. USB reference and UTMI gates are separate from resets
  and do not execute a PHY initialization sequence. The third reference
  gate (CRG0xbc bit2) and UTMI gate (CRG0xb8 bit7) are used by the EC6110-T
  760 firmware in addition to the two-port SPC060 configuration.

  The display clock tree uses the 24 MHz oscillator and HPLL, the CRG211
  top divider and the CRG54 VO divider. Pixel rates are programmable from
  25 to 594 MHz; this is not a display-controller mode-size guarantee.
  CRG54 gates are bus bit0, HD bit4 and configuration bit30. CRG211 bit14
  gates the display core; its bit29 divider reset is released before the
  VOU consumer enables clocks and releases CRG54 bit29. HDMI uses its
  native CRG67 SSC, bypass, oscillator, OS, AS and pixel gates, plus the
  CRG68 TMDS gate. CV200 video-layer gate bits are reserved on MV310.

properties:
  compatible:
    items:
      - const: hisilicon,hi3798mv310-crg
      - const: syscon

  reg:
    maxItems: 1

  clocks:
    maxItems: 1

  clock-names:
    const: osc

  '#clock-cells':
    const: 1

  '#reset-cells':
    const: 2
    description: |
      The first cell is the aligned CRG register byte offset. The second
      cell is a bit index from 0 to 31. Resets assert when the bit is set;
      there is no active-low flag. Clock and reset RMW operations share
      the CRG lock. MMC reset requests are at offsets 0xa0, 0x9c and 0x28c,
      bit4. The MAC reset request is at 0xd0 bit3 and FEPHY at 0x388 bit4.
      USB controller requests are at 0xb8 and PHY requests at 0xbc.

required:
  - compatible
  - reg
  - clocks
  - clock-names
  - '#clock-cells'
  - '#reset-cells'

additionalProperties: false

examples:
  - |
    clock-controller@f8a22000 {
        compatible = "hisilicon,hi3798mv310-crg", "syscon";
        reg = <0xf8a22000 0x1000>;
        clocks = <&osc>;
        clock-names = "osc";
        #clock-cells = <1>;
        #reset-cells = <2>;
    };
...
```

## Documentation/devicetree/bindings/cpufreq/hisilicon,hi3798cv200-avs.yaml
```yaml
# SPDX-License-Identifier: (GPL-2.0-only OR BSD-2-Clause)
%YAML 1.2
---
$id: http://devicetree.org/schemas/cpufreq/hisilicon,hi3798cv200-avs.yaml#
$schema: http://devicetree.org/meta-schemas/core.yaml#

title: HiSilicon Hi3798CV200 CPU HPM monitor

maintainers:
  - linux-pm@vger.kernel.org

description: |
  Access to the CPU HPM records and AVS enable control used by cpufreq-dt.
  Voltage and frequency operating points remain board policy in the CPU
  operating-points-v2 table.

properties:
  compatible:
    const: hisilicon,hi3798cv200-avs

  reg:
    maxItems: 2

  reg-names:
    items:
      - const: hpm
      - const: control

  hisilicon,hpm-targets:
    description: |
      Board-characterized CPU HPM policy. Each row contains the CPU frequency
      in Hz, the 10-bit HPM target and a boolean indicating whether software
      voltage feedback is enabled at that frequency.
    $ref: /schemas/types.yaml#/definitions/uint32-matrix
    minItems: 1
    maxItems: 16
    items:
      items:
        - description: CPU frequency in Hz
        - description: HPM target
          maximum: 1017
        - description: Enable software voltage feedback
          enum: [0, 1]

required:
  - compatible
  - reg
  - reg-names
  - hisilicon,hpm-targets

additionalProperties: false

examples:
  - |
    soc {
        #address-cells = <1>;
        #size-cells = <1>;

        cpu-avs@8a23078 {
            compatible = "hisilicon,hi3798cv200-avs";
            reg = <0x8a23078 0x10>, <0x8a23368 0x4>;
            reg-names = "hpm", "control";
            hisilicon,hpm-targets = <400000000 0xc9 0>,
                                     <600000000 0xc9 0>,
                                     <800000000 0xe5 1>,
                                     <1200000000 0x110 1>;
        };
    };
...
```

## Documentation/devicetree/bindings/display/hisilicon/hisilicon,hi3798cv200-hdmi.yaml
```yaml
# SPDX-License-Identifier: (GPL-2.0-only OR BSD-2-Clause)
%YAML 1.2
---
$id: http://devicetree.org/schemas/display/hisilicon/hisilicon,hi3798cv200-hdmi.yaml#
$schema: http://devicetree.org/meta-schemas/core.yaml#

title: HiSilicon Hi3798CV200 HDMI transmitter

maintainers:
  - dri-devel@lists.freedesktop.org

description:
  The Hi3798CV200 integrates an HDMI 2.0 transmitter with an internal DDC
  controller, hot-plug detection, CEC controller and TMDS PHY.

properties:
  compatible:
    const: hisilicon,hi3798cv200-hdmi

  reg:
    maxItems: 1

  interrupts:
    items:
      - description: HDMI transmitter interrupt
      - description: CEC interrupt

  interrupt-names:
    items:
      - const: tx
      - const: cec

  clocks:
    items:
      - description: APB bus clock
      - description: CEC clock
      - description: Input data clock
      - description: MHL clock
      - description: TMDS oversampling clock
      - description: Audio sample clock
      - description: Transmitter reference clock
      - description: Pixel-N clock
      - description: Pixel clock

  clock-names:
    items:
      - const: bus
      - const: cec
      - const: id
      - const: mhl
      - const: os
      - const: as
      - const: x
      - const: pixel-nx
      - const: pixel

  resets:
    items:
      - description: HDMI bus reset
      - description: HDMI transmitter reset
      - description: HDMI PHY reset

  reset-names:
    items:
      - const: bus
      - const: core
      - const: phy

  hisilicon,perictrl:
    $ref: /schemas/types.yaml#/definitions/phandle-array
    items:
      - items:
          - description: Phandle to the peripheral control syscon
          - description: Offset of the HDMI transmitter control register
    description:
      Peripheral control register used to select the transmitter pad and PHY
      routing.

  hisilicon,hpd-poll:
    type: boolean
    description:
      Use the official R002-style register poller for TX HPD/RSEN. The
      poller starts after 150 ms and repeats every 10 ms; no physical TX IRQ
      is requested. Use this when the exposed aggregate
      interrupt remains asserted despite the status being handled in the
      transmitter block.

  ports:
    $ref: /schemas/graph.yaml#/properties/ports

    properties:
      port@0:
        $ref: /schemas/graph.yaml#/properties/port
        description: Parallel video input from the display processor

      port@1:
        $ref: /schemas/graph.yaml#/properties/port
        description: HDMI output to the board connector

    required:
      - port@0
      - port@1

    unevaluatedProperties: false

required:
  - compatible
  - reg
  - interrupts
  - interrupt-names
  - clocks
  - clock-names
  - resets
  - reset-names
  - hisilicon,perictrl
  - ports

additionalProperties: false

examples:
  - |
    #include <dt-bindings/clock/histb-clock.h>
    #include <dt-bindings/interrupt-controller/arm-gic.h>

    hdmi@f8ce0000 {
        compatible = "hisilicon,hi3798cv200-hdmi";
        reg = <0xf8ce0000 0x20000>;
        interrupts = <GIC_SPI 88 IRQ_TYPE_LEVEL_HIGH>,
                     <GIC_SPI 147 IRQ_TYPE_LEVEL_HIGH>;
        interrupt-names = "tx", "cec";
        clocks = <&crg HISTB_HDMI_BUS_CLK>,
                 <&crg HISTB_HDMI_CEC_CLK>,
                 <&crg HISTB_HDMI_ID_CLK>,
                 <&crg HISTB_HDMI_MHL_CLK>,
                 <&crg HISTB_HDMI_OS_CLK>,
                 <&crg HISTB_HDMI_AS_CLK>,
                 <&crg HISTB_HDMI_X_CLK>,
                 <&crg HISTB_HDMI_PIXEL_NX_CLK>,
                 <&crg HISTB_HDMI_PIXEL_CLK>;
        clock-names = "bus", "cec", "id", "mhl", "os", "as", "x",
                      "pixel-nx", "pixel";
        resets = <&crg 0x10c 8>, <&crg 0x10c 9>, <&crg 0x110 4>;
        reset-names = "bus", "core", "phy";
        hisilicon,perictrl = <&perictrl 0x8b0>;

        ports {
            #address-cells = <1>;
            #size-cells = <0>;

            port@0 {
                reg = <0>;

                hdmi_in: endpoint {
                    remote-endpoint = <&vdp_out>;
                };
            };

            port@1 {
                reg = <1>;

                hdmi_out: endpoint {
                    remote-endpoint = <&hdmi_connector_in>;
                };
            };
        };
    };

    hdmi-connector {
        compatible = "hdmi-connector";
        type = "a";

        port {
            hdmi_connector_in: endpoint {
                remote-endpoint = <&hdmi_out>;
            };
        };
    };

    display-controller {
        port {
            vdp_out: endpoint {
                remote-endpoint = <&hdmi_in>;
            };
        };
    };
```

## Documentation/devicetree/bindings/display/hisilicon/hisilicon,hi3798cv200-vdp.yaml
```yaml
# SPDX-License-Identifier: (GPL-2.0-only OR BSD-2-Clause)
%YAML 1.2
---
$id: http://devicetree.org/schemas/display/hisilicon/hisilicon,hi3798cv200-vdp.yaml#
$schema: http://devicetree.org/meta-schemas/core.yaml#

title: HiSilicon Hi3798CV200 and Hi3798MV310 video display processors

maintainers:
  - dri-devel@lists.freedesktop.org

description:
  The Hi3798CV200 and Hi3798MV310 video display processors read graphics and
  video planes from memory, blend them, and generate SoC display timings.
  MV310 uses a separate graphics fetch engine and supports a primary linear
  RGB graphics plane up to 4096x2160 without scaling, with progressive
  display timings up to 594 MHz and 60 Hz. Its VOU reset is distinct from
  the pixel clock divider reset owned by the clock provider.
  CV200 routes G0, G1 and physical G3 through GP0, and V0/V1 through VP0.
  The final mixer orders these two groups; an independent VP1 is not used.

properties:
  compatible:
    enum:
      - hisilicon,hi3798cv200-vdp
      - hisilicon,hi3798mv310-vdp

  reg:
    maxItems: 1

  interrupts:
    maxItems: 1

  clocks:
    minItems: 4
    items:
      - description: Video output bus clock
      - description: Video output high-definition clock
      - description: Display processor configuration clock
      - description: Display processor high-definition core clock
      - description: Primary video plane clock
      - description: Primary graphics plane clock
      - description: Video output pixel bypass clock feeding the HDMI interface
      - description: Second HD graphics fetch clock (physical G1)
      - description: Third HD graphics fetch clock (physical G3)
      - description: Secondary video fetch clock (V1)
  clock-names:
    minItems: 4
    items:
      - const: bus
      - const: hd
      - const: config
      - const: core
      - const: video
      - const: graphics
      - const: bp
      - const: graphics1
      - const: graphics3
      - const: video1
  resets:
    maxItems: 1

  reset-names:
    const: vdp

  ports:
    $ref: /schemas/graph.yaml#/properties/ports

    properties:
      port@0:
        $ref: /schemas/graph.yaml#/properties/port
        description: Primary high-definition display output

      port@1:
        $ref: /schemas/graph.yaml#/properties/port
        description: Secondary display output

    required:
      - port@0

    unevaluatedProperties: false

required:
  - compatible
  - reg
  - interrupts
  - clocks
  - clock-names
  - resets
  - reset-names
  - ports

allOf:
  - if:
      properties:
        compatible:
          const: hisilicon,hi3798mv310-vdp
    then:
      properties:
        clocks:
          maxItems: 4
        clock-names:
          maxItems: 4
        ports:
          properties:
            port@1: false
    else:
      properties:
        clocks:
          minItems: 10
        clock-names:
          minItems: 10

additionalProperties: false

examples:
  - |
    #include <dt-bindings/clock/histb-clock.h>
    #include <dt-bindings/interrupt-controller/arm-gic.h>

    display-controller@f8cc0000 {
        compatible = "hisilicon,hi3798cv200-vdp";
        reg = <0xf8cc0000 0x10000>;
        interrupts = <GIC_SPI 90 IRQ_TYPE_LEVEL_HIGH>;
        clocks = <&crg HISTB_VO_BUS_CLK>,
                 <&crg HISTB_VO_HD_CLK>,
                 <&crg HISTB_VDP_CFG_CLK>,
                 <&crg HISTB_VDP_HD_CLK>,
                 <&crg HISTB_VDP_V0_CLK>,
                 <&crg HISTB_VDP_G0_CLK>,
                 <&crg HISTB_VO_BP_CLK>,
                 <&crg HISTB_VDP_G1_CLK>,
                 <&crg HISTB_VDP_G3_CLK>,
                 <&crg HISTB_VDP_V1_CLK>;
        clock-names = "bus", "hd", "config", "core", "video", "graphics", "bp",
                      "graphics1", "graphics3", "video1";
        resets = <&crg 0xd8 30>;
        reset-names = "vdp";

        ports {
            #address-cells = <1>;
            #size-cells = <0>;

            port@0 {
                reg = <0>;

                vdp_hd0_out: endpoint {
                    remote-endpoint = <&hdmi_in>;
                };
            };
        };
    };

    hdmi-transmitter {
        ports {
            #address-cells = <1>;
            #size-cells = <0>;

            port@0 {
                reg = <0>;

                hdmi_in: endpoint {
                    remote-endpoint = <&vdp_hd0_out>;
                };
            };
        };
    };
```
