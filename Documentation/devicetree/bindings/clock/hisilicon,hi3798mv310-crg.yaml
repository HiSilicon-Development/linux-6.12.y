## Documentation/devicetree/bindings/media/hisilicon,hi3798cv200-vdec.yaml
```yaml
# SPDX-License-Identifier: (GPL-2.0-only OR BSD-2-Clause)
%YAML 1.2
---
$id: http://devicetree.org/schemas/media/hisilicon,hi3798cv200-vdec.yaml#
$schema: http://devicetree.org/meta-schemas/core.yaml#

title: HiSilicon HiSTB video decoders

maintainers:
  - linux-media@vger.kernel.org

description:
  Hi3798CV200 and Hi3798MV310 contain video decoding, stream code detection,
  bit-plane decoding and local memory management engines with distinct
  register and message protocols. MV310 uses internal wrapper resets and
  a CRG mux, not the CV200 VDH/DSP/BPD gates and external reset bits.
  Reconstruction and firmware storage use a dedicated DMA pool; CV200 uses
  a non-reusable pool, while MV310 can use a reusable CMA pool.
  Capture storage uses a separate reusable CMA pool within the device DMA
  aperture, so native UHD output does not exhaust display scanout memory.
  Capture DMA-BUFs retain this allocation context until their final release.

properties:
  compatible:
    enum:
      - hisilicon,hi3798cv200-vdec
      - hisilicon,hi3798mv310-vdec

  reg:
    maxItems: 1

  interrupts:
    items:
      - description: Video decoding hardware interrupt
      - description: Stream code detector interrupt
      - description: Decoder memory management unit interrupt

  interrupt-names:
    items:
      - const: vdh
      - const: scd
      - const: mmu

  clocks:
    items:
      - description: Video decoding hardware clock
      - description: Video decoder DSP clock
      - description: Bit-plane decoder clock

  clock-names:
    items:
      - const: vdh
      - const: dsp
      - const: bpd

  resets:
    items:
      - description: Video decoding hardware reset
      - description: Stream code detector reset
      - description: Main format decoding engine reset
      - description: Bit-plane decoder reset

  reset-names:
    items:
      - const: vdh
      - const: scd
      - const: mfd
      - const: bpd

  hisilicon,vpss:
    $ref: /schemas/types.yaml#/definitions/phandle
    description: Video post-processing engine used for tile-to-linear output

  hisilicon,crg-syscon:
    $ref: /schemas/types.yaml#/definitions/phandle
    description: MV310 CRG syscon containing the VDH mux at offset 0x78

  memory-region:
    items:
      - description: Dedicated DMA pool for reconstruction and firmware buffers
      - description: Reusable CMA pool for cacheable, contiguous capture buffers

  memory-region-names:
    items:
      - const: reconstruction
      - const: capture

required:
  - compatible
  - reg
  - interrupts
  - interrupt-names
  - hisilicon,vpss
  - memory-region
  - memory-region-names

allOf:
  - if:
      properties:
        compatible:
          const: hisilicon,hi3798mv310-vdec
    then:
      properties:
        clocks: false
        clock-names: false
        resets: false
        reset-names: false
      required:
        - hisilicon,crg-syscon
    else:
      properties:
        hisilicon,crg-syscon: false
      required:
        - clocks
        - clock-names
        - resets
        - reset-names

additionalProperties: false

examples:
  - |
    #include <dt-bindings/clock/histb-clock.h>
    #include <dt-bindings/interrupt-controller/arm-gic.h>

    video-codec@f8c30000 {
        compatible = "hisilicon,hi3798cv200-vdec";
        reg = <0xf8c30000 0x10000>;
        interrupts = <GIC_SPI 95 IRQ_TYPE_LEVEL_HIGH>,
                     <GIC_SPI 104 IRQ_TYPE_LEVEL_HIGH>,
                     <GIC_SPI 149 IRQ_TYPE_LEVEL_HIGH>;
        interrupt-names = "vdh", "scd", "mmu";
        clocks = <&crg HISTB_VDH_CLK>,
                 <&crg HISTB_VDH_DSP_CLK>,
                 <&crg HISTB_BPD_CLK>;
        clock-names = "vdh", "dsp", "bpd";
        resets = <&crg 0x78 4>, <&crg 0x78 5>,
                 <&crg 0x78 6>, <&crg 0x88 4>;
        reset-names = "vdh", "scd", "mfd", "bpd";
        hisilicon,vpss = <0x1>;
        memory-region = <&vdec_pool>, <&capture_cma>;
        memory-region-names = "reconstruction", "capture";
    };
```

## Documentation/devicetree/bindings/media/hisilicon,hi3798cv200-venc.yaml
```yaml
# SPDX-License-Identifier: (GPL-2.0-only OR BSD-2-Clause)
%YAML 1.2
---
$id: http://devicetree.org/schemas/media/hisilicon,hi3798cv200-venc.yaml#
$schema: http://devicetree.org/meta-schemas/core.yaml#

title: HiSilicon HiSTB video encoders

maintainers:
  - linux-media@vger.kernel.org

description:
  Hi3798CV200 uses the first-generation VEDU H.264 encoder and a separate
  JPGE block. Hi3798MV310 uses V500 for H.264 and HEVC encoding, with a
  separate SMMU clock and reset. They have different register protocols.

properties:
  compatible:
    enum:
      - hisilicon,hi3798cv200-venc
      - hisilicon,hi3798mv310-venc

  reg:
    maxItems: 1

  interrupts:
    maxItems: 1

  clocks:
    minItems: 2
    items:
      - description: Video encoder core clock
      - description: Video encoder AXI clock
      - description: Video encoder SMMU clock

  clock-names:
    minItems: 2
    items:
      - const: core
      - const: axi
      - const: smmu

  resets:
    minItems: 1
    maxItems: 2

  reset-names:
    oneOf:
      - const: venc
      - items:
          - const: core
          - const: smmu

  assigned-clocks:
    maxItems: 1

  assigned-clock-rates:
    maxItems: 1

  memory-region:
    maxItems: 1
    description: Dedicated DMA pool for encoder bitstream and reconstruction buffers.
required:
  - compatible
  - reg
  - interrupts
  - clocks
  - clock-names
  - resets
  - reset-names

allOf:
  - if:
      properties:
        compatible:
          const: hisilicon,hi3798cv200-venc
    then:
      properties:
        clocks:
          maxItems: 2
        clock-names:
          maxItems: 2
        resets:
          maxItems: 1
        reset-names:
          const: venc
    else:
      properties:
        clocks:
          minItems: 3
        clock-names:
          minItems: 3
        resets:
          minItems: 2
        reset-names:
          items:
            - const: core
            - const: smmu

additionalProperties: false

examples:
  - |
    #include <dt-bindings/clock/histb-clock.h>
    #include <dt-bindings/interrupt-controller/arm-gic.h>

    video-codec@f8c80000 {
        compatible = "hisilicon,hi3798cv200-venc";
        reg = <0xf8c80000 0x10000>;
        interrupts = <GIC_SPI 101 IRQ_TYPE_LEVEL_HIGH>;
        clocks = <&crg HISTB_VENC_CORE_CLK>,
                 <&crg HISTB_VENC_AXI_CLK>;
        clock-names = "core", "axi";
        resets = <&crg 0x8c 4>;
        reset-names = "venc";
    };
```

## Documentation/devicetree/bindings/media/hisilicon,hi3798cv200-vpss.yaml
```yaml
# SPDX-License-Identifier: (GPL-2.0-only OR BSD-2-Clause)
%YAML 1.2
---
$id: http://devicetree.org/schemas/media/hisilicon,hi3798cv200-vpss.yaml#
$schema: http://devicetree.org/meta-schemas/core.yaml#

title: HiSilicon Hi3798CV200 video post-processing subsystem

maintainers:
  - linux-media@vger.kernel.org

description:
  The VPSS block converts native decoder tile surfaces into linear frames and
  provides scaling, noise reduction and deinterlacing pipelines.

properties:
  compatible:
    const: hisilicon,hi3798cv200-vpss

  reg:
    maxItems: 1

  interrupts:
    maxItems: 1

  clocks:
    maxItems: 1

  clock-names:
    const: core

  resets:
    maxItems: 1

  reset-names:
    const: core

required:
  - compatible
  - reg
  - interrupts
  - clocks
  - clock-names
  - resets
  - reset-names

additionalProperties: false

examples:
  - |
    #include <dt-bindings/clock/histb-clock.h>
    #include <dt-bindings/interrupt-controller/arm-gic.h>

    video-post-processing@f8cb0000 {
        compatible = "hisilicon,hi3798cv200-vpss";
        reg = <0xf8cb0000 0x10000>;
        interrupts = <GIC_SPI 93 IRQ_TYPE_LEVEL_HIGH>;
        clocks = <&crg HISTB_VPSS_CLK>;
        clock-names = "core";
        resets = <&crg 0xf0 4>;
        reset-names = "core";
    };
```

## Documentation/devicetree/bindings/media/hisilicon,hi3798mv310-png.yaml
```yaml
# SPDX-License-Identifier: (GPL-2.0-only OR BSD-2-Clause)
%YAML 1.2
---
$id: http://devicetree.org/schemas/media/hisilicon,hi3798mv310-png.yaml#
$schema: http://devicetree.org/meta-schemas/core.yaml#

title: HiSilicon Hi3798MV310 PNG decoder

maintainers:
  - linux-media@vger.kernel.org

description:
  PNG decoder and integrated SMMU. The core register span is 0x120 bytes;
  the aperture also includes the SMMU registers at offset 0xf000.

properties:
  compatible:
    const: hisilicon,hi3798mv310-png

  reg:
    maxItems: 1

  interrupts:
    maxItems: 1

  clocks:
    items:
      - description: PNG decoder core clock
      - description: PNG decoder SMMU clock

  clock-names:
    items:
      - const: core
      - const: smmu

  resets:
    items:
      - description: PNG decoder core reset
      - description: PNG decoder SMMU reset

  reset-names:
    items:
      - const: core
      - const: smmu

required:
  - compatible
  - reg
  - interrupts
  - clocks
  - clock-names
  - resets
  - reset-names

additionalProperties: false
```

## Documentation/devicetree/bindings/media/hix5hd2-ir.txt
```
Device-Tree bindings for hix5hd2 ir IP

Required properties:
	- compatible: Should contain one of:
		- "hisilicon,hi3796cv300-ir" for Hi3796CV300 IR device
		- "hisilicon,hi3798cv200-ir" for Hi3798CV200 IR device
		- "hisilicon,hi3798mv310-ir" for Hi3798MV310 IR device
		- "hisilicon,hix5hd2-ir" for HIX5HD2 IR device
	  These identify different controller variants. Hi3798CV200/MV310 use
	  direct interrupt-level encoding and must not list hix5hd2-ir as a
	  fallback compatible. MV310 uses the 24 MHz oscillator and sysctrl
	  offset 0x48 bits 4 (gate) and 5 (reset).
	- reg: Base physical address of the controller and length of memory
	  mapped region.
	- interrupts: interrupt-specifier for the sole interrupt generated by
	  the device. The interrupt specifier format depends on the interrupt
	  controller parent.
	- clocks: clock phandle and specifier pair.

Optional properties:
	- linux,rc-map-name: see rc.txt file in the same directory.
	- hisilicon,power-syscon: system-controller phandle used by integrations
		that gate or reset the receiver outside the clock provider.

Example node:

	ir: ir@f8001000 {
		compatible = "hisilicon,hix5hd2-ir";
		reg = <0xf8001000 0x1000>;
		interrupts = <0 47 4>;
		clocks = <&clock HIX5HD2_IR_CLOCK>;
		linux,rc-map-name = "rc-tivo";
	};
```

## Documentation/devicetree/bindings/media/maxlinear,mxl214.yaml
```yaml
# SPDX-License-Identifier: (GPL-2.0-only OR BSD-2-Clause)
%YAML 1.2
---
$id: http://devicetree.org/schemas/media/maxlinear,mxl214.yaml#
$schema: http://devicetree.org/meta-schemas/core.yaml#

title: MaxLinear MxL214 and MxL214C four-channel DVB-C receiver

maintainers:
  - linux-media@vger.kernel.org

description:
  The MxL214 family contains a full-band cable tuner and four DVB-C demodulators.
  Each demodulator has an independent MPEG transport stream output while all
  channels share one I2C control interface and reset input.

properties:
  compatible:
    oneOf:
      - const: maxlinear,mxl214
      - items:
          - const: maxlinear,mxl214c
          - const: maxlinear,mxl214

  reg:
    maxItems: 1

  reset-gpios:
    description: Active-low hardware reset input
    maxItems: 1

  maxlinear,ts-mode:
    description: >-
      Three-wire outputs use independent gated clocks with SYNC and DATA.
      Four-wire outputs use the common clock with SYNC, VALID and DATA and
      require a silicon revision supporting that mode.
    enum: [serial-3wire, serial-4wire]
    default: serial-4wire

  ports:
    $ref: /schemas/graph.yaml#/properties/ports

    properties:
      port@0:
        $ref: /schemas/graph.yaml#/$defs/port-base
        unevaluatedProperties: false
        description: MPEG transport stream output

        properties:
          reg:
            const: 0

          endpoint:
            $ref: /schemas/graph.yaml#/$defs/endpoint-base
            unevaluatedProperties: false

            properties:
              remote-endpoint: true

            required:
              - remote-endpoint

        required:
          - endpoint

      port@1:
        $ref: /schemas/graph.yaml#/$defs/port-base
        unevaluatedProperties: false
        description: MPEG transport stream output

        properties:
          reg:
            const: 1

          endpoint:
            $ref: /schemas/graph.yaml#/$defs/endpoint-base
            unevaluatedProperties: false

            properties:
              remote-endpoint: true

            required:
              - remote-endpoint

        required:
          - endpoint

      port@2:
        $ref: /schemas/graph.yaml#/$defs/port-base
        unevaluatedProperties: false
        description: MPEG transport stream output

        properties:
          reg:
            const: 2

          endpoint:
            $ref: /schemas/graph.yaml#/$defs/endpoint-base
            unevaluatedProperties: false

            properties:
              remote-endpoint: true

            required:
              - remote-endpoint

        required:
          - endpoint

      port@3:
        $ref: /schemas/graph.yaml#/$defs/port-base
        unevaluatedProperties: false
        description: MPEG transport stream output

        properties:
          reg:
            const: 3

          endpoint:
            $ref: /schemas/graph.yaml#/$defs/endpoint-base
            unevaluatedProperties: false

            properties:
              remote-endpoint: true

            required:
              - remote-endpoint

        required:
          - endpoint

    required:
      - port@0
      - port@1
      - port@2
      - port@3

required:
  - compatible
  - reg
  - reset-gpios
  - ports

additionalProperties: false

examples:
  - |
    #include <dt-bindings/gpio/gpio.h>

    i2c {
        #address-cells = <1>;
        #size-cells = <0>;

        demodulator@50 {
            compatible = "maxlinear,mxl214";
            reg = <0x50>;
            reset-gpios = <&gpio7 4 GPIO_ACTIVE_LOW>;

            ports {
                #address-cells = <1>;
                #size-cells = <0>;

                port@0 {
                    reg = <0>;

                    endpoint {
                        remote-endpoint = <&demux_input0>;
                    };
                };

                port@1 {
                    reg = <1>;

                    endpoint {
                        remote-endpoint = <&demux_input1>;
                    };
                };

                port@2 {
                    reg = <2>;

                    endpoint {
                        remote-endpoint = <&demux_input2>;
                    };
                };

                port@3 {
                    reg = <3>;

                    endpoint {
                        remote-endpoint = <&demux_input3>;
                    };
                };
            };
        };
    };
...
```
