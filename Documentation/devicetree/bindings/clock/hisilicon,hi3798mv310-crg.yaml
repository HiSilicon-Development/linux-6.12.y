## Documentation/devicetree/bindings/media/tuners/rafael,r858.yaml
```yaml
# SPDX-License-Identifier: (GPL-2.0-only OR BSD-2-Clause)
%YAML 1.2
---
$id: http://devicetree.org/schemas/media/tuners/rafael,r858.yaml#
$schema: http://devicetree.org/meta-schemas/core.yaml#

title: Rafael Micro R858 internal DVB-C receiver

maintainers:
  - Linux Media Mailing List <linux-media@vger.kernel.org>

description: |
  An R858 package contains two addressed receivers with shared LNA, ring PLL
  and crystal resources. Receiver configuration nodes can be children of a
  demodulator without sharing its I2C bus. Each receiver explicitly identifies
  its tuner adapter with i2c-parent; no demodulator repeater is implied. The
  parent binding may reference this schema without requiring compatible on
  that child. Each endpoint describes its other internal receiver with peer.
  Different demodulator I2C controllers do not identify R858 package wiring.

  Linux addresses are seven-bit. Vendor addresses 0x14 and 0x34 correspond to
  0x0a and 0x1a. They must not be confused with internal receiver indices or
  an external package's crystal role. Both endpoints must be reachable for
  calibration, including when only one frontend is in use. Shared package
  configuration (reference frequency, crystal role/capacitance, clock output
  and RF loop-through) must agree in both endpoint nodes.
  The supported profiles use a 24 MHz reference, DVB-C Annex A, an 8 MHz
  channel filter and either 5 MHz or 5.5 MHz IF. Both internal receivers
  complete their explicitly selected profile's LPF and image-rejection
  calibration before the package becomes ready. Each endpoint's profile
  remains fixed for the package lifetime, including while the peer frontend
  is unattached. The endpoint properties, not the internal receiver indices,
  select the IF profiles.

properties:
  compatible:
    const: rafael,r858

  reg:
    maxItems: 1
    description: Seven-bit I2C address of this internal receiver.

  i2c-parent:
    $ref: /schemas/types.yaml#/definitions/phandle
    description: |
      I2C controller or adapter carrying this internal tuner endpoint. This
      can differ from the demodulator's parent bus. Both internal receivers
      on a directly connected R858 package reference the same tuner adapter.

  rafael,tuner-index:
    $ref: /schemas/types.yaml#/definitions/uint32
    enum: [0, 1]
    description: Internal receiver number, not a package number.

  rafael,peer:
    $ref: /schemas/types.yaml#/definitions/phandle
    description: |
      The other internal receiver node in this same package. The reference
      must be reciprocal. Its reg and i2c-parent identify the peer address
      and adapter. Receiver index zero owns the shared primary registers.

  clock-frequency:
    const: 24000000
    description: R858 crystal or externally supplied reference frequency in Hz.

  rafael,if-frequency-hz:
    enum: [5000000, 5500000]
    description: |
      Analog IF presented to this receiver's demodulator, in Hz. The
      integrating driver must resolve both endpoint IF values before the
      first tuner initialization.

  rafael,xtal-role:
    $ref: /schemas/types.yaml#/definitions/uint32
    enum: [0, 1, 2, 3]
    description: |
      Package crystal wiring per the Rafael reference. 0 is an independent
      self-oscillating package; 1 is a master forwarding its reference to a
      slave package; 2 is an external-reference input forwarding the reference;
      3 is an external-reference input without forwarding. This is not the
      internal receiver number. Roles 1 and 2 require clock-out.

  rafael,xtal-cap:
    $ref: /schemas/types.yaml#/definitions/uint32
    minimum: 0
    maximum: 31
    description: Vendor crystal-capacitance code, not a capacitance in pF.

  rafael,loop-through:
    type: boolean
    description: Keep active RF loop-through enabled, including in standby.

  rafael,clock-out:
    type: boolean
    description: Enable the outgoing reference for a chained package.

required:
  - reg
  - i2c-parent
  - rafael,tuner-index
  - rafael,peer
  - clock-frequency
  - rafael,if-frequency-hz
  - rafael,xtal-role
  - rafael,xtal-cap

allOf:
  - if:
      properties:
        rafael,xtal-role:
          enum: [1, 2]
    then:
      required:
        - rafael,clock-out

additionalProperties: false
...
```

## Documentation/devicetree/bindings/mmc/hisilicon,hi3798cv200-dw-mshc.yaml
```yaml
# SPDX-License-Identifier: GPL-2.0-only OR BSD-2-Clause
%YAML 1.2
---
$id: http://devicetree.org/schemas/mmc/hisilicon,hi3798cv200-dw-mshc.yaml#
$schema: http://devicetree.org/meta-schemas/core.yaml#

title: Hisilicon HiSTB SoCs specific extensions to the Synopsys DWMMC controller

maintainers:
  - Yang Xiwen <forbidden405@outlook.com>

properties:
  compatible:
    enum:
      - hisilicon,hi3798cv200-dw-mshc
      - hisilicon,hi3798mv200-dw-mshc

  reg:
    maxItems: 1

  interrupts:
    maxItems: 1

  clocks:
    items:
      - description: bus interface unit clock
      - description: card interface unit clock
      - description: card input sample phase clock
      - description: controller output drive phase clock

  clock-names:
    items:
      - const: ciu
      - const: biu
      - const: ciu-sample
      - const: ciu-drive

  hisilicon,sap-dll-reg:
    $ref: /schemas/types.yaml#/definitions/phandle-array
    description: |
      DWMMC core on Hi3798MV2x SoCs has a delay-locked-loop(DLL) attached to card data input path.
      It is integrated into CRG core on the SoC and has to be controlled during tuning.
    items:
      - description: A phandle pointed to the CRG syscon node
      - description: Sample DLL register offset in CRG address space

  hisilicon,io-voltage-reg:
    $ref: /schemas/types.yaml#/definitions/phandle-array
    description: |
      A phandle to the system controller and the register offset whose bit 0
      reports the eMMC I/O voltage selected by the board. A set bit reports
      1.8 V and a clear bit reports 3.3 V. The driver uses the read-only value
      to select the captured DDR52 sample phase; it never changes the voltage.
    items:
      - items:
          - description: A phandle to the system controller syscon node
          - description: I/O voltage status register offset

  hisilicon,hs400-strobe-reg:
    $ref: /schemas/types.yaml#/definitions/phandle-array
    description: |
      CRG syscon register containing the CV200 HS400 data-strobe enable
      bit and delay field. The driver either inherits a bootloader-qualified
      delay or tunes phases 1 through 15 with repeated EXT_CSD reads.
    items:
      - items:
          - description: A phandle to the CRG syscon node
          - description: HS400 data-strobe register offset

  hisilicon,inherit-boot-tuning:
    type: boolean
    description: |
      Preserve the HS200 sample phase and HS400 data-strobe delay qualified by
      the bootloader when they are usable. The driver captures both values
      before its first timing transition and validates the sample phase with
      CMD21. A stale or invalid hand-off is not fatal: Linux disables
      inheritance and actively retunes the sample and data-strobe windows.
      Validated values are restored whenever the card returns to HS400.

dependencies:
  hisilicon,inherit-boot-tuning:
    - hisilicon,hs400-strobe-reg
    - hisilicon,io-voltage-reg

required:
  - compatible
  - reg
  - interrupts
  - clocks
  - clock-names

allOf:
  - $ref: synopsys-dw-mshc-common.yaml#

  - if:
      properties:
        compatible:
          contains:
            const: hisilicon,hi3798mv200-dw-mshc
    then:
      required:
        - hisilicon,sap-dll-reg
      properties:
        hisilicon,io-voltage-reg: false
        hisilicon,hs400-strobe-reg: false
        hisilicon,inherit-boot-tuning: false
    else:
      properties:
        hisilicon,sap-dll-reg: false

unevaluatedProperties: false

examples:
  - |
    #include <dt-bindings/clock/histb-clock.h>
    #include <dt-bindings/interrupt-controller/arm-gic.h>

    mmc@9830000 {
        compatible = "hisilicon,hi3798cv200-dw-mshc";
        reg = <0x9830000 0x10000>;
        interrupts = <GIC_SPI 35 IRQ_TYPE_LEVEL_HIGH>;
        clocks = <&crg HISTB_MMC_CIU_CLK>,
                 <&crg HISTB_MMC_BIU_CLK>,
                 <&crg HISTB_MMC_SAMPLE_CLK>,
                 <&crg HISTB_MMC_DRV_CLK>;
        clock-names = "ciu", "biu", "ciu-sample", "ciu-drive";
        resets = <&crg 0xa0 4>;
        reset-names = "reset";
        hisilicon,io-voltage-reg = <&sysctrl 0xf4>;
        hisilicon,hs400-strobe-reg = <&crg 0x290>;
        hisilicon,inherit-boot-tuning;
        pinctrl-names = "default", "hs200", "hs400";
        pinctrl-0 = <&emmc_pins_1>;
        pinctrl-1 = <&emmc_hs200_pins>;
        pinctrl-2 = <&emmc_hs400_pins>;
        fifo-depth = <256>;
        clock-frequency = <150000000>;
        max-frequency = <150000000>;
        cap-mmc-highspeed;
        mmc-ddr-1_8v;
        mmc-hs200-1_8v;
        mmc-hs400-1_8v;
        non-removable;
        bus-width = <8>;
    };
```

## Documentation/devicetree/bindings/net/hisilicon,hi3798mv310-femac.yaml
```yaml
# SPDX-License-Identifier: (GPL-2.0-only OR BSD-2-Clause)
%YAML 1.2
---
$id: http://devicetree.org/schemas/net/hisilicon,hi3798mv310-femac.yaml#
$schema: http://devicetree.org/meta-schemas/core.yaml#

title: HiSilicon Hi3798MV310 Fast Ethernet MAC and internal PHY

maintainers:
  - Dongpo Li <lidongpo@hisilicon.com>

description: |
  The Hi3798MV310 switch-fabric Ethernet controller provides a port-0 FIFO
  datapath, an MDIO controller at offset 0x1100, and global registers at
  offset 0x1300. The internal Fast Ethernet PHY uses MII. Its LDO and MDIO
  address latch are in the peripheral-control syscon, while its clock and
  reset are provided by the CRG. Power, reset and analog trimming must finish
  before the integrated MDIO bus probes the PHY.

  The PHY address comes from the PHY node's reg property and is programmed
  into the address latch before reset. A PHY identity must be read from
  hardware, not supplied as an ethernet-phy-id compatible. No compatible
  fallback to another SoC or separate MDIO platform device is required.

  If firmware actually supplies the legacy /chiptrim/chiptrim0 handoff,
  the driver decodes its LD amplitude bits 15:11, LDO amplitude bits 10:8,
  and resistor trim bits 5:0. A supplied zero word uses the vendor's
  documented 0x0e/0x03/0x16 defaults. Absent handoff data instead uses the
  hardware ATE auto-trim completion protocol; board DTS files must not
  invent trim values.

allOf:
  - $ref: ethernet-controller.yaml#

properties:
  compatible:
    const: hisilicon,hi3798mv310-femac

  reg:
    maxItems: 1

  interrupts:
    maxItems: 1

  clocks:
    items:
      - description: MAC clocks, CRG 0xd0 bits 1:0 with bit 2 cleared
      - description: Internal PHY clock, CRG 0x388 bit 0

  clock-names:
    items:
      - const: mac
      - const: phy

  resets:
    items:
      - description: MAC reset, CRG 0xd0 bit 3
      - description: Internal PHY reset, CRG 0x388 bit 4

  reset-names:
    items:
      - const: mac
      - const: phy

  hisilicon,peri-syscon:
    $ref: /schemas/types.yaml#/definitions/phandle
    description: |
      Peripheral-control syscon containing the PHY address latch at 0x118
      (bits 4:0), and internal PHY LDO control at 0x844 (set bits 4 and 6,
      clear bits 5 and 7).

  phy-mode:
    const: mii

  phy-handle: true

  fixed-link: false

  mdio:
    $ref: mdio.yaml#
    unevaluatedProperties: false
    description: Integrated MDIO bus, with the internal PHY as a child
    patternProperties:
      '^ethernet-phy@[0-9a-f]+$':
        type: object
        $ref: ethernet-phy.yaml#
        unevaluatedProperties: false
        properties:
          compatible:
            const: ethernet-phy-ieee802.3-c22

required:
  - compatible
  - reg
  - interrupts
  - clocks
  - clock-names
  - resets
  - reset-names
  - hisilicon,peri-syscon
  - phy-mode
  - phy-handle
  - mdio

unevaluatedProperties: false

examples:
  - |
    #include <dt-bindings/clock/hi3798mv310-clock.h>
    #include <dt-bindings/interrupt-controller/arm-gic.h>

    ethernet@f9c30000 {
        compatible = "hisilicon,hi3798mv310-femac";
        reg = <0xf9c30000 0x4000>;
        interrupts = <GIC_SPI 72 IRQ_TYPE_LEVEL_HIGH>;
        clocks = <&crg HI3798MV310_ETH_MAC>, <&crg HI3798MV310_ETH_PHY>;
        clock-names = "mac", "phy";
        resets = <&crg 0xd0 3>, <&crg 0x388 4>;
        reset-names = "mac", "phy";
        hisilicon,peri-syscon = <&peri_ctrl>;
        phy-mode = "mii";
        phy-handle = <&internal_phy>;

        mdio {
            #address-cells = <1>;
            #size-cells = <0>;

            internal_phy: ethernet-phy@2 {
                reg = <2>;
            };
        };
    };
...
```

## Documentation/devicetree/bindings/nvmem/hisilicon,hi3798mv310-otp.yaml
```yaml
# SPDX-License-Identifier: (GPL-2.0-only OR BSD-2-Clause)
%YAML 1.2
---
$id: http://devicetree.org/schemas/nvmem/hisilicon,hi3798mv310-otp.yaml#
$schema: http://devicetree.org/meta-schemas/core.yaml#

title: HiSilicon Hi3798MV310 calibration OTP

maintainers:
  - HiSilicon <linux@hisilicon.com>

description: |
  Read-only access to the temperature calibration word at OTP address 0x258
  and CPU voltage trim bytes at 0x44c and 0x44e. The provider serializes read
  transactions and restores controller state. OTP programming, device
  identifiers and key material are not exposed.

allOf:
  - $ref: nvmem.yaml#

properties:
  compatible:
    const: hisilicon,hi3798mv310-otp
  reg:
    maxItems: 1
  '#address-cells':
    const: 1
  '#size-cells':
    const: 1

  temperature@258:
    type: object
    properties:
      reg:
        maxItems: 1
    required:
      - reg
    additionalProperties: false


  cpu-1200m@44c:
    type: object
    properties:
      reg:
        maxItems: 1
    required:
      - reg
    additionalProperties: false

  cpu-800m@44e:
    type: object
    properties:
      reg:
        maxItems: 1
    required:
      - reg
    additionalProperties: false
required:
  - compatible
  - reg
  - '#address-cells'
  - '#size-cells'

unevaluatedProperties: false
```
