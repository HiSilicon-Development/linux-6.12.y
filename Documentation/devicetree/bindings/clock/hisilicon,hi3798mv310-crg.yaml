## Documentation/devicetree/bindings/display/hisilicon/hisilicon,hi3798mv310-hdmi.yaml
```yaml
# SPDX-License-Identifier: (GPL-2.0-only OR BSD-2-Clause)
%YAML 1.2
---
$id: http://devicetree.org/schemas/display/hisilicon/hisilicon,hi3798mv310-hdmi.yaml#
$schema: http://devicetree.org/meta-schemas/core.yaml#

title: HiSilicon Hi3798MV310 hisiv100 HDMI transmitter

maintainers:
  - dri-devel@lists.freedesktop.org

description: |
  The MV310 uses a hisiv100 native-register HDMI controller and a separate
  HDMI analogue/digital PHY, not the CV200 imagev200 register interface.
  The driver supports progressive SDR RGB video at 8 bits per component,
  with a 25 to 594 MHz TMDS character clock. Rates above 340 MHz require
  HDMI 2.0 SCDC scrambling and the 1:40 clock ratio on a capable sink.
  Stereo I2S PCM audio supports 32/44.1/48/88.2/96/176.4/192 kHz and
  16 or 24 significant bits, constrained by the HDMI sink's ELD. AIAO's
  24-bit DMA samples use S32_LE containers. HDCP and CEC are not implemented.
  HPD is always read from the physical AON status bit; when
  the optional AON interrupt is absent it is polled at 100 ms intervals.
  No connected display or EDID is required for bridge registration.

properties:
  compatible:
    const: hisilicon,hi3798mv310-hdmi

  '#sound-dai-cells':
    const: 0

  reg:
    items:
      - description: HDMI controller at 0xf8ce0000, including its AON block
      - description: External HDMI PHY at 0xf8d30000

  reg-names:
    items:
      - const: core
      - const: phy

  interrupts:
    maxItems: 1
    description: HDMI AON HPD interrupt, not the CV200 transmitter interrupt

  interrupt-names:
    items:
      - const: aon

  clocks:
    items:
      - description: SSC input gate, sourced from the HPLL divided by two
      - description: SSC bypass gate
      - description: HDMI controller 24 MHz oscillator gate
      - description: HDMI controller oversampling gate
      - description: HDMI controller audio-sample domain gate
      - description: PHY TMDS gate
      - description: Pixel clock, including HPLL and VO/HDMI divider programming

  clock-names:
    items:
      - const: ssc
      - const: ssc-bypass
      - const: osc
      - const: os
      - const: as
      - const: tmds
      - const: pixel

  resets:
    items:
      - description: CRG HDMI controller bus reset
      - description: CRG HDMI controller reset
      - description: CRG HDMI SSC reset
      - description: CRG external HDMI PHY reset
      - description: CRG PHY TMDS reset

  reset-names:
    items:
      - const: bus
      - const: core
      - const: ssc
      - const: phy
      - const: tmds

  hisilicon,sysctrl:
    $ref: /schemas/types.yaml#/definitions/phandle
    description: |
      System controller containing HDMI pin routing at offset 0x44
      (bits 24 to 21) and AON APB/oscillator/CEC gates and resets at
      offset 0x48 (bits 19 to 24). These fields are managed by the bridge.

  hisilicon,perictrl:
    $ref: /schemas/types.yaml#/definitions/phandle
    description: Peripheral controller containing the HDMI audio source mux at 0x8b0.

  ports:
    $ref: /schemas/graph.yaml#/properties/ports
    properties:
      port@0:
        $ref: /schemas/graph.yaml#/properties/port
        description: Native parallel RGB input from the VDP
      port@1:
        $ref: /schemas/graph.yaml#/properties/port
        description: HDMI output to the board connector
    required:
      - port@0
      - port@1
    unevaluatedProperties: false

dependencies:
  interrupts: [interrupt-names]
  interrupt-names: [interrupts]

required:
  - compatible
  - reg
  - reg-names
  - clocks
  - clock-names
  - resets
  - reset-names
  - hisilicon,sysctrl
  - hisilicon,perictrl
  - ports

additionalProperties: false
```

## Documentation/devicetree/bindings/i2c/i2c-hix5hd2.txt
```
I2C for Hisilicon hix5hd2 chipset platform

Required properties:
- compatible: Must be "hisilicon,hix5hd2-i2c". Hi3798CV200 controllers
  should use "hisilicon,hi3798cv200-i2c", "hisilicon,hix5hd2-i2c".
- reg: physical base address of the controller and length of memory mapped
     region.
- interrupts: interrupt number to the cpu.
- #address-cells = <1>;
- #size-cells = <0>;
- clocks: phandles to input clocks.

Optional properties:
- clock-frequency: Desired I2C bus frequency in Hz, otherwise defaults to 100000
- resets: phandle to the controller reset line.
- Child nodes conforming to i2c bus binding

Examples:
I2C0@f8b10000 {
	compatible = "hisilicon,hix5hd2-i2c";
	reg = <0xf8b10000 0x1000>;
	interrupts = <0 38 4>;
	clocks = <&clock HIX5HD2_I2C0_RST>;
	resets = <&crg 0x6c 5>;
	#address-cells = <1>;
	#size-cells = <0>;
}
```

## Documentation/devicetree/bindings/media/hisilicon,hi3130.yaml
```yaml
# SPDX-License-Identifier: (GPL-2.0-only OR BSD-2-Clause)
%YAML 1.2
---
$id: http://devicetree.org/schemas/media/hisilicon,hi3130.yaml#
$schema: http://devicetree.org/meta-schemas/core.yaml#

title: HiSilicon external Hi3130 DVB-C demodulator

maintainers:
  - linux-media@vger.kernel.org

description: |
  One external DVB-C Annex A demodulator with an R858 RF receiver. The
  implemented silicon is v200, identified by register 0x40 bits 7:5 equal
  to 5; the vendor's 3130_outside board enum does not identify a revision.
  Other silicon revisions are not supported. The programming data requires
  a 28.8 MHz demodulator sample/master clock, an internal ADC, CMOS AGC,
  two's-complement ADC data and 5 MHz or 5.5 MHz tuner IF. These are not
  defaults for undocumented boards. Serial-nosync describes the receiver
  connection:
  packet synchronization is obtained in-band, not from a wired SYNC pin.
  The demodulator serial clock selection is the SDK's 74.25 MHz setting.
  The standard demodulator pad assignment is used: all six IOSHARE
  selectors for TS data, valid, sync and clock are programmed to zero,
  corresponding to the vendor TSOUT identity assignment 0 through 10.
  Tuner control uses the direct I2C adapter explicitly referenced by each
  tuner child's i2c-parent property, independently of the demodulator's
  host adapter. No demodulator repeater is required for this connection.

  An R858 package contains two internal receivers. Calibration accesses
  both. Each tuner child therefore references its peer explicitly; neither
  the enclosing demodulator nor its host bus establishes tuner routing.
  Both internal receivers of a directly connected package reference the
  same tuner I2C controller and describe the same package crystal wiring,
  capacitance, clock output and loop-through. The peer need not have an
  enabled or acquired DVB frontend, but its I2C bus must exist and the
  physical endpoint must be reachable.

properties:
  compatible:
    const: hisilicon,hi3130

  reg:
    maxItems: 1

  reset-gpios:
    description: Active-low external demodulator reset (100 ms assertion)
    maxItems: 1

  clock-frequency:
    description: Demodulator master/sample clock frequency in Hz
    const: 28800000

  hisilicon,ts-mode:
    const: serial-nosync

  '#address-cells':
    const: 1

  '#size-cells':
    const: 0

  port:
    $ref: /schemas/graph.yaml#/properties/port
    description: Serial MPEG transport stream output

patternProperties:
  '^tuner@[0-9a-f]+$':
    $ref: /schemas/media/tuners/rafael,r858.yaml#
    properties:
      rafael,if-frequency-hz:
        enum: [5000000, 5500000]
    required:
      - i2c-parent
required:
  - compatible
  - reg
  - reset-gpios
  - clock-frequency
  - hisilicon,ts-mode
  - '#address-cells'
  - '#size-cells'
  - port

additionalProperties: false
...
```

## Documentation/devicetree/bindings/media/hisilicon,hi3798-jpgd.yaml
```yaml
# SPDX-License-Identifier: (GPL-2.0-only OR BSD-2-Clause)
%YAML 1.2
---
$id: http://devicetree.org/schemas/media/hisilicon,hi3798-jpgd.yaml#
$schema: http://devicetree.org/meta-schemas/core.yaml#

title: HiSilicon HiSTB JPEG decoders

maintainers:
  - linux-media@vger.kernel.org

description:
  Stand-alone baseline JPEG decoder with a core and an integrated SMMU.
  The register aperture includes the SMMU registers at offset 0xf000.

properties:
  compatible:
    enum:
      - hisilicon,hi3798cv200-jpgd
      - hisilicon,hi3798mv310-jpgd

  reg:
    maxItems: 1

  interrupts:
    maxItems: 1

  clocks:
    items:
      - description: JPEG decoder core clock
      - description: JPEG decoder SMMU clock

  clock-names:
    items:
      - const: core
      - const: smmu

  resets:
    items:
      - description: JPEG decoder core reset
      - description: JPEG decoder SMMU reset

  reset-names:
    items:
      - const: core
      - const: smmu

required:
  - compatible
  - reg
  - interrupts
  - clocks
  - clock-names
  - resets
  - reset-names

additionalProperties: false
```

## Documentation/devicetree/bindings/media/hisilicon,hi3798cv200-demux.yaml
```yaml
# SPDX-License-Identifier: (GPL-2.0-only OR BSD-2-Clause)
%YAML 1.2
---
$id: http://devicetree.org/schemas/media/hisilicon,hi3798cv200-demux.yaml#
$schema: http://devicetree.org/meta-schemas/core.yaml#

title: HiSilicon Hi3798CV200 transport stream demultiplexer

maintainers:
  - linux-media@vger.kernel.org

description:
  The Hi3798CV200 demultiplexer receives up to six external MPEG transport
  streams and transfers packet data to memory through descriptor queues. Each
  enabled input is exposed as an independent Linux DVB adapter.

properties:
  compatible:
    const: hisilicon,hi3798cv200-demux

  reg:
    maxItems: 1

  interrupts:
    maxItems: 1

  clocks:
    items:
      - description: Demultiplexer bus clock
      - description: Demultiplexer core clock
      - description: Demultiplexer 27 MHz reference clock
      - description: Transport stream input 0 clock
      - description: Transport stream input 1 clock
      - description: Transport stream input 2 clock
      - description: Transport stream input 3 clock
      - description: Transport stream input 4 clock
      - description: Transport stream input 5 clock
      - description: Shared clock selector for transport stream inputs 0 to 3

  clock-names:
    items:
      - const: bus
      - const: core
      - const: ref
      - const: tsi0
      - const: tsi1
      - const: tsi2
      - const: tsi3
      - const: tsi4
      - const: tsi5
      - const: tsi-shared

  assigned-clocks:
    maxItems: 1

  assigned-clock-parents:
    maxItems: 1

  resets:
    maxItems: 1

  reset-names:
    const: demux

  "#address-cells":
    const: 1

  "#size-cells":
    const: 0

patternProperties:
  "^input@[0-5]$":
    type: object
    additionalProperties: false

    properties:
      reg:
        minimum: 0
        maximum: 5

      hisilicon,ts-mode:
        description: Physical transport stream signalling mode
        enum:
          - parallel-valid
          - parallel-nosync-188
          - parallel-nosync-204
          - parallel-nosync-auto
          - serial-sync
          - serial-nosync
          - serial-nosync-novalid

      hisilicon,clock-inverted:
        description: Sample transport stream data on the opposite clock edge
        type: boolean

      hisilicon,serial-data-line:
        $ref: /schemas/types.yaml#/definitions/uint32
        description:
          Physical data line used in serial mode. Line 0 is the hardware
          default for HiSilicon DVB frontends.
        enum: [0, 7]
        default: 0

      hisilicon,cv200-legacy-ts-tuning:
        description: >-
          Use the CV200 serial transport setup: FIFO rate/mode fields and the
          dummy-sync pulse around stream start/stop. This is a board-level
          compatibility option and must only be set when the board uses this
          CV200 TSI sequence.
        type: boolean

      hisilicon,hardware-pid-filtering:
        description: >-
          Use the hardware SELECT_PID record path and route only explicitly
          requested PID channels into the record output queue.
          Selected packets retain their original scrambling state for Linux
          DVB user-space descramblers until a live PID is bound through the CA
          interface. The record path then follows the hardware descrambler for
          that input.
          Without this property the driver records the complete multiplex and
          uses the Linux DVB software demultiplexer. Wildcard feeds still
          select complete-multiplex recording. This is board integration
          policy, not a generic CV200 capability declaration.
        type: boolean

      port:
        $ref: /schemas/graph.yaml#/$defs/port-base
        unevaluatedProperties: false
        description: MPEG transport stream input

        properties:
          endpoint:
            $ref: /schemas/graph.yaml#/$defs/endpoint-base
            unevaluatedProperties: false

            properties:
              remote-endpoint: true

            required:
              - remote-endpoint

        required:
          - endpoint

    required:
      - reg
      - hisilicon,ts-mode

required:
  - compatible
  - reg
  - interrupts
  - clocks
  - clock-names
  - resets
  - reset-names
  - "#address-cells"
  - "#size-cells"

additionalProperties: false

examples:
  - |
    #include <dt-bindings/clock/histb-clock.h>
    #include <dt-bindings/interrupt-controller/arm-gic.h>

    demux@f9c00000 {
        compatible = "hisilicon,hi3798cv200-demux";
        reg = <0xf9c00000 0x10000>;
        interrupts = <GIC_SPI 82 IRQ_TYPE_LEVEL_HIGH>;
        clocks = <&crg HISTB_DMX_BUS_CLK>,
                 <&crg HISTB_DMX_CLK>,
                 <&crg HISTB_DMX_27M_CLK>,
                 <&crg HISTB_TSI0_CLK>,
                 <&crg HISTB_TSI1_CLK>,
                 <&crg HISTB_TSI2_CLK>,
                 <&crg HISTB_TSI3_CLK>,
                 <&crg HISTB_TSI4_CLK>,
                 <&crg HISTB_TSI5_CLK>,
                 <&crg HISTB_TSI_SHARED_CLK>;
        clock-names = "bus", "core", "ref", "tsi0", "tsi1", "tsi2",
                      "tsi3", "tsi4", "tsi5", "tsi-shared";
        assigned-clocks = <&crg HISTB_TSI_SHARED_CLK>;
        assigned-clock-parents = <&crg HISTB_TSI2_CLK>;
        resets = <&crg 0xfc 24>;
        reset-names = "demux";
        #address-cells = <1>;
        #size-cells = <0>;

        input@0 {
            reg = <0>;
            hisilicon,ts-mode = "serial-nosync";
            hisilicon,clock-inverted;
            hisilicon,serial-data-line = <0>;

            port {
                demux_input0: endpoint {
                    remote-endpoint = <&mxl214_output0>;
                };
            };
        };
    };
...
```

## Documentation/devicetree/bindings/media/hisilicon,hi3798cv200-jpge.yaml
```yaml
# SPDX-License-Identifier: (GPL-2.0-only OR BSD-2-Clause)
%YAML 1.2
---
$id: http://devicetree.org/schemas/media/hisilicon,hi3798cv200-jpge.yaml#
$schema: http://devicetree.org/meta-schemas/core.yaml#

title: HiSilicon Hi3798CV200 JPEG encoder

maintainers:
  - linux-media@vger.kernel.org

description:
  The JPGE block in the Hi3798CV200 encodes raw YUV frames as baseline JPEG.
  It is independent from the H.264 VEDU block at a neighbouring address.

properties:
  compatible:
    const: hisilicon,hi3798cv200-jpge

  reg:
    maxItems: 1

  interrupts:
    maxItems: 1

  clocks:
    maxItems: 1

  clock-names:
    const: core

  resets:
    maxItems: 1

  reset-names:
    const: jpge

required:
  - compatible
  - reg
  - interrupts
  - clocks
  - clock-names
  - resets
  - reset-names

additionalProperties: false

examples:
  - |
    #include <dt-bindings/clock/histb-clock.h>
    #include <dt-bindings/interrupt-controller/arm-gic.h>

    jpeg-encoder@f8c90000 {
        compatible = "hisilicon,hi3798cv200-jpge";
        reg = <0xf8c90000 0x10000>;
        interrupts = <GIC_SPI 102 IRQ_TYPE_LEVEL_HIGH>;
        clocks = <&crg HISTB_JPGE_CLK>;
        clock-names = "core";
        resets = <&crg 0x90 4>;
        reset-names = "jpge";
    };
```
