## Documentation/devicetree/bindings/rng/hisilicon,histb-rng.yaml
```yaml
# SPDX-License-Identifier: (GPL-2.0 OR BSD-2-Clause)
%YAML 1.2
---
$id: http://devicetree.org/schemas/rng/hisilicon,histb-rng.yaml#
$schema: http://devicetree.org/meta-schemas/core.yaml#

title: HiSilicon STB True Random Number Generator

maintainers:
  - David Yang <mmyangfl@gmail.com>

properties:
  compatible:
    enum:
      - hisilicon,histb-rng
      - hisilicon,hi3798cv200-rng

  reg:
    maxItems: 1

required:
  - compatible
  - reg

additionalProperties: false

examples:
  - |
    rng@f8005200 {
        compatible = "hisilicon,hi3798cv200-rng";
        reg = <0xf8005200 0x10>;
    };
```

## Documentation/devicetree/bindings/serial/hisilicon,hi3798cv200-sci.yaml
```yaml
# SPDX-License-Identifier: (GPL-2.0-only OR BSD-2-Clause)
%YAML 1.2
---
$id: http://devicetree.org/schemas/serial/hisilicon,hi3798cv200-sci.yaml#
$schema: http://devicetree.org/meta-schemas/core.yaml#

title: HiSilicon Hi3798CV200 smart card interface

maintainers:
  - linux-serial@vger.kernel.org

description:
  The Hi3798CV200 smart card interface is an ISO/IEC 7816 controller with
  hardware-managed card power, clock, reset, presence detection and byte
  FIFOs. It is exposed through the Linux serial core ISO7816 interface.

allOf:
  - $ref: serial.yaml#

properties:
  compatible:
    const: hisilicon,hi3798cv200-sci

  reg:
    maxItems: 1

  interrupts:
    maxItems: 1

  clocks:
    maxItems: 1

  clock-names:
    const: sci

  resets:
    maxItems: 1

  reset-names:
    const: sci

  hisilicon,vcc-active-low:
    description: The controller VCC-enable output is active low
    type: boolean

  hisilicon,card-detect-active-high:
    description: The controller card-detect input reports presence as high
    type: boolean

  hisilicon,clock-open-drain:
    description:
      Drive the smart card clock output in open-drain mode. When absent, the
      output uses CMOS mode.
    type: boolean

  hisilicon,reset-open-drain:
    description:
      Drive the smart card reset output in open-drain mode. When absent, the
      output uses CMOS mode.
    type: boolean

  hisilicon,vcc-enable-open-drain:
    description:
      Drive the card VCC-enable output in open-drain mode. When absent, the
      output uses CMOS mode.
    type: boolean

required:
  - compatible
  - reg
  - interrupts
  - clocks
  - clock-names
  - resets
  - reset-names

unevaluatedProperties: false

examples:
  - |
    #include <dt-bindings/clock/histb-clock.h>
    #include <dt-bindings/interrupt-controller/arm-gic.h>

    serial@f8b18000 {
        compatible = "hisilicon,hi3798cv200-sci";
        reg = <0xf8b18000 0x1000>;
        interrupts = <GIC_SPI 36 IRQ_TYPE_LEVEL_HIGH>;
        clocks = <&crg HISTB_SCI_CLK>;
        clock-names = "sci";
        resets = <&crg 0x74 1>;
        reset-names = "sci";
        hisilicon,vcc-active-low;
        hisilicon,card-detect-active-high;
    };
...
```

## Documentation/devicetree/bindings/sound/hisilicon,hi3798cv200-aiao.yaml
```yaml
# SPDX-License-Identifier: (GPL-2.0-only OR BSD-2-Clause)
%YAML 1.2
---
$id: http://devicetree.org/schemas/sound/hisilicon,hi3798cv200-aiao.yaml#
$schema: http://devicetree.org/meta-schemas/core.yaml#

title: HiSilicon Hi3798CV200 AIAO controller

maintainers:
  - linux-sound@vger.kernel.org

description:
  The Audio Input/Audio Output controller contains serial audio interfaces and
  native circular DMA buffers. A selected transmit interface is exposed as a
  standard ASoC DAI. Board routing selects the transmit channel; TX0 is the
  default. The channel selects its DMA bank, clock source and IRQ.
  The PCM DMA path accepts signed 16-bit samples or 24 significant bits in
  the most significant bits of a 32-bit word (ALSA S32_LE with msbits 24).
  Low-justified S24_LE is not a native DMA format.
  CV200 uses the 933.888 MHz audio PLL, while MV310 uses the BSP's
  860.160 MHz source and has a different internal HDMI transmit port.

properties:
  compatible:
    enum:
      - hisilicon,hi3798cv200-aiao
      - hisilicon,hi3798mv310-aiao

  reg:
    maxItems: 1

  interrupts:
    maxItems: 1

  clocks:
    items:
      - description: AIAO working clock
      - description: Audio master PLL clock
  clock-names:
    items:
      - const: bus
      - const: mclk
  resets:
    maxItems: 1

  "#sound-dai-cells":
    const: 1
    description: |
      DAI 0 is the board-selected analog/external I2S port. DAI 1 is the
      internal HDMI port (TX3 on CV200, TX2 on MV310). The two PCM devices
      share the driver's DMA state and cannot be opened simultaneously.

  hisilicon,tx-channel:
    $ref: /schemas/types.yaml#/definitions/uint32
    minimum: 0
    maximum: 3
    default: 0
    description: Analog/external I2S transmit port index (DAI 0 only).

required:
  - compatible
  - reg
  - interrupts
  - clocks
  - clock-names
  - resets
  - "#sound-dai-cells"

allOf:
  - $ref: dai-common.yaml#

unevaluatedProperties: false

examples:
  - |
    #include <dt-bindings/clock/histb-clock.h>
    #include <dt-bindings/interrupt-controller/arm-gic.h>

    audio-controller@f8cd0000 {
        compatible = "hisilicon,hi3798cv200-aiao";
        reg = <0xf8cd0000 0x10000>;
        interrupts = <GIC_SPI 84 IRQ_TYPE_LEVEL_HIGH>;
        clocks = <&crg HISTB_AIAO_CLK>, <&crg HISTB_AIAO_MCLK>;
        clock-names = "bus", "mclk";
        resets = <&crg 0x118 4>;
        #sound-dai-cells = <1>;
    };
...
```

## Documentation/devicetree/bindings/sound/hisilicon,hi3798cv200-tianlai-codec.yaml
```yaml
# SPDX-License-Identifier: (GPL-2.0-only OR BSD-2-Clause)
%YAML 1.2
---
$id: http://devicetree.org/schemas/sound/hisilicon,hi3798cv200-tianlai-codec.yaml#
$schema: http://devicetree.org/meta-schemas/core.yaml#

title: HiSilicon Hi3798CV200 Tianlai internal DAC

maintainers:
  - linux-sound@vger.kernel.org

description:
  The Tianlai block is the stereo digital-to-analog converter integrated in
  the Hi3798CV200 peripheral controller.

properties:
  compatible:
    const: hisilicon,hi3798cv200-tianlai-codec

  reg:
    items:
      - description: Digital DAC control register
      - description: Serial data and pop control register
      - description: Analog DAC control register

  clocks:
    maxItems: 1

  resets:
    maxItems: 1

  mute-gpios:
    maxItems: 1
    description: Optional external analog output mute control

  "#sound-dai-cells":
    const: 0

required:
  - compatible
  - reg
  - clocks
  - resets
  - "#sound-dai-cells"

allOf:
  - $ref: dai-common.yaml#

unevaluatedProperties: false

examples:
  - |
    #include <dt-bindings/clock/histb-clock.h>
    #include <dt-bindings/gpio/gpio.h>

    audio-codec@110 {
        compatible = "hisilicon,hi3798cv200-tianlai-codec";
        reg = <0x110 0x4>, <0x114 0x4>, <0x160 0x4>;
        clocks = <&crg HISTB_ADAC_CLK>;
        resets = <&crg 0x114 4>;
        mute-gpios = <&gpio9 0 GPIO_ACTIVE_LOW>;
        #sound-dai-cells = <0>;
    };
...
```

## Documentation/devicetree/bindings/timer/hisilicon,hi3798cv200-timer.yaml
```yaml
# SPDX-License-Identifier: (GPL-2.0-only OR BSD-2-Clause)
%YAML 1.2
---
$id: http://devicetree.org/schemas/timer/hisilicon,hi3798cv200-timer.yaml#
$schema: http://devicetree.org/meta-schemas/core.yaml#

title: HiSilicon Hi3798CV200 system timers

maintainers:
  - linux-kernel@vger.kernel.org

description: |
  The Hi3798CV200 provides five independent SP804-compatible 32-bit timer
  channels. One channel is used as a free-running system clocksource and the
  remaining four channels provide one clock event interrupt per CPU.

properties:
  compatible:
    const: hisilicon,hi3798cv200-timer

  reg:
    items:
      - description: Free-running clocksource channel
      - description: CPU0 clock event channel
      - description: CPU1 clock event channel
      - description: CPU2 clock event channel
      - description: CPU3 clock event channel

  reg-names:
    items:
      - const: clocksource
      - const: cpu0
      - const: cpu1
      - const: cpu2
      - const: cpu3

  interrupts:
    items:
      - description: CPU0 clock event interrupt
      - description: CPU1 clock event interrupt
      - description: CPU2 clock event interrupt
      - description: CPU3 clock event interrupt

  interrupt-names:
    items:
      - const: cpu0
      - const: cpu1
      - const: cpu2
      - const: cpu3

  clocks:
    maxItems: 1

  clock-names:
    const: timer

required:
  - compatible
  - reg
  - reg-names
  - interrupts
  - interrupt-names
  - clocks
  - clock-names

additionalProperties: false

examples:
  - |
    #include <dt-bindings/interrupt-controller/arm-gic.h>
    #include <dt-bindings/interrupt-controller/irq.h>

    timer_clk: clock-24000000 {
        compatible = "fixed-clock";
        #clock-cells = <0>;
        clock-frequency = <24000000>;
    };

    timer@f8a29000 {
        compatible = "hisilicon,hi3798cv200-timer";
        reg = <0xf8a29000 0x20>,
              <0xf8a2a000 0x20>,
              <0xf8a2a020 0x20>,
              <0xf8a2b000 0x20>,
              <0xf8a2b020 0x20>;
        reg-names = "clocksource", "cpu0", "cpu1", "cpu2", "cpu3";
        interrupts = <GIC_SPI 26 IRQ_TYPE_LEVEL_HIGH>,
                     <GIC_SPI 59 IRQ_TYPE_LEVEL_HIGH>,
                     <GIC_SPI 27 IRQ_TYPE_LEVEL_HIGH>,
                     <GIC_SPI 60 IRQ_TYPE_LEVEL_HIGH>;
        interrupt-names = "cpu0", "cpu1", "cpu2", "cpu3";
        clocks = <&timer_clk>;
        clock-names = "timer";
    };
...
```

## arch/arm64/configs/ec6110t_mv310_defconfig
```kconfig
CONFIG_LOCALVERSION="-ec6110t-mv310"
# CONFIG_LOCALVERSION_AUTO is not set
CONFIG_SYSVIPC=y
CONFIG_POSIX_MQUEUE=y
CONFIG_HIGH_RES_TIMERS=y
CONFIG_NO_HZ_IDLE=y
CONFIG_IKCONFIG=y
CONFIG_IKCONFIG_PROC=y
CONFIG_CGROUPS=y
CONFIG_BLK_CGROUP=y
CONFIG_CGROUP_SCHED=y
CONFIG_CFS_BANDWIDTH=y
CONFIG_CGROUP_PIDS=y
CONFIG_CGROUP_FREEZER=y
CONFIG_CGROUP_HUGETLB=y
CONFIG_CGROUP_DEVICE=y
CONFIG_CGROUP_CPUACCT=y
CONFIG_CGROUP_PERF=y
CONFIG_CGROUP_BPF=y
CONFIG_CGROUP_MISC=y
CONFIG_CHECKPOINT_RESTORE=y
CONFIG_BPF_SYSCALL=y
CONFIG_BPF_JIT=y
CONFIG_SECCOMP=y
CONFIG_SECCOMP_FILTER=y
CONFIG_MEMCG=y
CONFIG_CPUSETS=y
CONFIG_NAMESPACES=y
CONFIG_USER_NS=y
CONFIG_BLK_DEV_INITRD=y
CONFIG_ARCH_HISI_HISTB=y
CONFIG_NR_CPUS=4
CONFIG_HZ_100=y
CONFIG_COMPAT=y
# CONFIG_EFI is not set
CONFIG_CPU_IDLE=y
CONFIG_HISTB_WFI_CPUIDLE=y
CONFIG_CPU_FREQ=y
CONFIG_CPU_FREQ_DEFAULT_GOV_SCHEDUTIL=y
CONFIG_CPU_FREQ_GOV_ONDEMAND=y
CONFIG_CPU_FREQ_GOV_SCHEDUTIL=y
CONFIG_CPUFREQ_DT=y
CONFIG_REGULATOR=y
CONFIG_REGULATOR_HI3798MV310=y
CONFIG_REGULATOR_HI3798MV310_SD_IO=y
CONFIG_NVMEM=y
CONFIG_NVMEM_HI3798MV310_OTP=y
CONFIG_THERMAL=y
CONFIG_THERMAL_GOV_STEP_WISE=y
CONFIG_CPU_THERMAL=y
CONFIG_HISI_THERMAL=y
CONFIG_HWMON=y
CONFIG_MODULES=y
CONFIG_MODULE_UNLOAD=y
CONFIG_MODVERSIONS=y
CONFIG_PARTITION_ADVANCED=y
CONFIG_CMDLINE_PARTITION=y
CONFIG_EFI_PARTITION=y
CONFIG_NET=y
CONFIG_PACKET=y
CONFIG_UNIX=y
CONFIG_INET=y
CONFIG_NETFILTER=y
CONFIG_BRIDGE_NETFILTER=m
CONFIG_NF_CONNTRACK=m
CONFIG_NF_TABLES=m
CONFIG_NF_TABLES_INET=y
CONFIG_NFT_CT=m
CONFIG_NFT_LOG=m
CONFIG_NFT_LIMIT=m
CONFIG_NFT_MASQ=m
CONFIG_NFT_NAT=m
CONFIG_NETFILTER_XT_TARGET_MASQUERADE=m
CONFIG_NETFILTER_XT_TARGET_REDIRECT=m
CONFIG_NETFILTER_XT_MATCH_ADDRTYPE=m
CONFIG_NETFILTER_XT_MATCH_CONNTRACK=m
CONFIG_NETFILTER_XT_MATCH_STATE=m
CONFIG_IP_NF_IPTABLES=m
CONFIG_IP_NF_FILTER=m
CONFIG_IP_NF_NAT=m
CONFIG_IP_NF_MANGLE=m
CONFIG_IP6_NF_IPTABLES=m
CONFIG_IP6_NF_FILTER=m
CONFIG_IP6_NF_MANGLE=m
CONFIG_BRIDGE=m
CONFIG_NET_SCHED=y
CONFIG_NET_SCH_HTB=m
CONFIG_NET_SCH_FQ_CODEL=m
CONFIG_NET_CLS_ACT=y
CONFIG_NET_ACT_MIRRED=m
CONFIG_DUMMY=m
CONFIG_MACVLAN=m
CONFIG_IPVLAN=m
CONFIG_VXLAN=m
CONFIG_TUN=m
CONFIG_VETH=m
CONFIG_IP_PNP=y
CONFIG_IP_PNP_DHCP=y
CONFIG_WIRELESS=y
CONFIG_CFG80211=m
CONFIG_MAC80211=m
CONFIG_RFKILL=m
CONFIG_BT=m
CONFIG_BT_BREDR=y
CONFIG_BT_LE=y
CONFIG_BT_RFCOMM=m
CONFIG_BT_RFCOMM_TTY=y
CONFIG_BT_BNEP=m
CONFIG_BT_HIDP=m
# CONFIG_BT_DEBUGFS is not set
CONFIG_BT_HCIBTUSB=m
# CONFIG_BT_HCIBTUSB_BCM is not set
CONFIG_BT_HCIBTUSB_MTK=y
CONFIG_BT_HCIBTUSB_RTL=y
CONFIG_BT_HCIBTSDIO=m
CONFIG_BT_HCIUART=m
CONFIG_BT_HCIUART_H4=y
CONFIG_BT_HCIUART_3WIRE=y
CONFIG_BT_HCIUART_RTL=y
CONFIG_BT_MTKSDIO=m
CONFIG_BT_MTKUART=m
CONFIG_DEVTMPFS=y
CONFIG_DEVTMPFS_MOUNT=y
CONFIG_NETDEVICES=y
CONFIG_HISI_FEMAC=y
CONFIG_USB_PEGASUS=m
CONFIG_USB_RTL8150=m
CONFIG_USB_RTL8152=m
CONFIG_USB_LAN78XX=m
CONFIG_USB_USBNET=m
CONFIG_USB_NET_AX8817X=m
CONFIG_USB_NET_AX88179_178A=m
CONFIG_USB_NET_CDCETHER=m
CONFIG_USB_NET_CDC_EEM=m
CONFIG_USB_NET_CDC_NCM=m
CONFIG_USB_NET_CDC_MBIM=m
CONFIG_USB_NET_CDC_SUBSET=m
CONFIG_USB_NET_ZAURUS=m
CONFIG_USB_NET_CX82310_ETH=m
CONFIG_USB_NET_QMI_WWAN=m
CONFIG_USB_NET_PLUSB=m
CONFIG_USB_NET_NET1080=m
CONFIG_USB_NET_DM9601=m
CONFIG_USB_NET_SR9700=m
CONFIG_USB_NET_SR9800=m
CONFIG_USB_NET_SMSC75XX=m
CONFIG_USB_NET_SMSC95XX=m
CONFIG_USB_NET_MCS7830=m
CONFIG_USB_NET_RNDIS_HOST=m
CONFIG_USB_NET_CH9200=m
CONFIG_USB_NET_AQC111=m
CONFIG_PHYLIB=y
CONFIG_REALTEK_PHY=y
CONFIG_WLAN=y
CONFIG_WLAN_VENDOR_MEDIATEK=y
CONFIG_MT7663U=m
CONFIG_MT7663S=m
CONFIG_WLAN_VENDOR_REALTEK=y
CONFIG_RTL8XXXU=m
CONFIG_RTW88=m
CONFIG_RTW88_8822BS=m
CONFIG_RTW88_8723DS=m
CONFIG_RTW88_8821CS=m
CONFIG_SERIAL_AMBA_PL011=y
CONFIG_SERIAL_AMBA_PL011_CONSOLE=y
CONFIG_SERIAL_EARLYCON=y
CONFIG_SERIAL_DEV_BUS=y
CONFIG_SERIAL_DEV_CTRL_TTYPORT=y
CONFIG_GPIOLIB=y
CONFIG_GPIO_PL061=y
CONFIG_CMA=y
CONFIG_DMA_CMA=y
CONFIG_CMA_SIZE_MBYTES=128
CONFIG_DRM=y
CONFIG_DRM_HISI_HISTB=m
CONFIG_DRM_HISI_HISTB_HDMI=m
CONFIG_DRM_FBDEV_EMULATION=y
CONFIG_DRM_LIMA=m
CONFIG_PM_DEVFREQ=y
CONFIG_DEVFREQ_GOV_SIMPLE_ONDEMAND=y
CONFIG_DEVFREQ_THERMAL=y
CONFIG_RC_CORE=m
CONFIG_LIRC=y
CONFIG_RC_DECODERS=y
CONFIG_IR_NEC_DECODER=m
CONFIG_IR_RC5_DECODER=m
CONFIG_IR_RC6_DECODER=m
CONFIG_RC_DEVICES=y
CONFIG_IR_HIX5HD2=m
CONFIG_MEDIA_SUPPORT=m
CONFIG_MEDIA_PLATFORM_SUPPORT=y
CONFIG_VIDEO_DEV=m
CONFIG_MEDIA_CONTROLLER=y
CONFIG_MEDIA_SUPPORT_FILTER=y
CONFIG_MEDIA_CAMERA_SUPPORT=y
CONFIG_MEDIA_DIGITAL_TV_SUPPORT=y
CONFIG_MEDIA_CONTROLLER_DVB=y
CONFIG_MEDIA_USB_SUPPORT=y
CONFIG_USB_VIDEO_CLASS=m
CONFIG_V4L_MEM2MEM_DRIVERS=y
CONFIG_VIDEO_HISTB_JPGD=m
CONFIG_VIDEO_HISTB_PNG=m
CONFIG_VIDEO_HISTB_VDEC=m
CONFIG_VIDEO_HISTB_VENC=m
# CONFIG_SOUND is not set
CONFIG_SCSI=y
CONFIG_BLK_DEV_SD=y
CONFIG_INPUT_EVDEV=y
CONFIG_USB=y
CONFIG_USB_EHCI_HCD=y
CONFIG_USB_EHCI_HCD_PLATFORM=y
CONFIG_USB_OHCI_HCD=y
CONFIG_USB_OHCI_HCD_PLATFORM=y
CONFIG_USB_STORAGE=y
CONFIG_USB_ANNOUNCE_NEW_DEVICES=y
CONFIG_USB_MON=m
CONFIG_USB_XHCI_HCD=m
CONFIG_USB_XHCI_PLATFORM=m
CONFIG_USB_XHCI_HISTB=m
CONFIG_USB_ACM=m
CONFIG_USB_PRINTER=m
CONFIG_USB_UAS=m
CONFIG_USB_SERIAL=m
CONFIG_USB_SERIAL_GENERIC=y
CONFIG_USB_SERIAL_CH341=m
CONFIG_USB_SERIAL_CP210X=m
CONFIG_USB_SERIAL_FTDI_SIO=m
CONFIG_USB_SERIAL_PL2303=m
CONFIG_USB_SERIAL_OPTION=m
CONFIG_USB_HID=y
CONFIG_MMC=y
CONFIG_MMC_BLOCK=y
CONFIG_MMC_DW=y
CONFIG_MMC_DW_PLTFM=y
CONFIG_MMC_DW_HI3798MV200=y
CONFIG_COMMON_CLK_HI3798MV310=y
CONFIG_PHY_HI3798MV310_USB2=y
CONFIG_PINCTRL_SINGLE=y
CONFIG_NEW_LEDS=y
CONFIG_LEDS_CLASS=m
CONFIG_EXT4_FS=y
CONFIG_FANOTIFY=y
CONFIG_AUTOFS_FS=m
CONFIG_FUSE_FS=m
CONFIG_OVERLAY_FS=y
CONFIG_SQUASHFS=m
CONFIG_SQUASHFS_XATTR=y
CONFIG_SQUASHFS_LZ4=y
CONFIG_SQUASHFS_XZ=y
CONFIG_SQUASHFS_ZSTD=y
CONFIG_UNIX98_PTYS=y
CONFIG_VFAT_FS=y
CONFIG_NTFS3_FS=y
CONFIG_TMPFS=y
CONFIG_TMPFS_POSIX_ACL=y
CONFIG_NLS_DEFAULT="utf8"
CONFIG_NLS_CODEPAGE_437=y
CONFIG_NLS_ISO8859_1=y
CONFIG_NLS_UTF8=y
CONFIG_PRINTK_TIME=y
CONFIG_MAGIC_SYSRQ=y
CONFIG_DEBUG_KERNEL=y
CONFIG_DEBUG_INFO_NONE=y
CONFIG_DEBUG_FS=y
CONFIG_WATCHDOG=y
CONFIG_ARM_SP805_WATCHDOG=y
```
