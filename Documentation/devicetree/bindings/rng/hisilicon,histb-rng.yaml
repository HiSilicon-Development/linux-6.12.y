## drivers/gpu/drm/bridge/hisilicon/Kconfig
```kconfig
# SPDX-License-Identifier: GPL-2.0-only

config DRM_HISI_HISTB_HDMI
	tristate "HiSilicon HiSTB HDMI transmitter"
	depends on DRM && OF && COMMON_CLK && I2C && RESET_CONTROLLER
	depends on ARCH_HISI || COMPILE_TEST
	select DRM_DISPLAY_HELPER
	select DRM_DISPLAY_HDMI_STATE_HELPER
	select DRM_DISPLAY_HDCP_HELPER
	select FW_LOADER
	select CRC32
	select DRM_KMS_HELPER
	select MFD_SYSCON
	select CEC_CORE
	select CEC_NOTIFIER
	select SND_SOC_HDMI_CODEC if SND_SOC
	help
	  Enable support for the HDMI transmitter integrated in the HiSilicon
	  Hi3798CV200 and Hi3798MV310. The drivers use the DRM bridge API and
	  provide physical hot-plug detection and internal DDC EDID reads.
	  MV310 uses its native hisiv100 controller and external HDMI PHY,
	  supporting progressive RGB video at 8 bpc and stereo I2S PCM. CV200
	  provides 2/6/8-channel LPCM and IEC61937/HBR audio through hdmi-codec
	  when ASoC is enabled, subject to sink capabilities. Board sound links
	  connect the AIAO CPU DAI to the transmitter's sound DAI.
	  CV200 also supports HDR10/HLG signaling for ten-bit BT.2020 RGB
	  scanout, and HDCP with the optional cipher/MCU resources and licensed
	  board firmware/key packages. These are not MV310 capabilities.

	  If M is selected, the modules are histb-hdmi and histb-hdmi-mv310.
```

## drivers/gpu/drm/hisilicon/histb/Kconfig
```kconfig
# SPDX-License-Identifier: GPL-2.0-only

config DRM_HISI_HISTB
	tristate "DRM support for HiSilicon HiSTB display controllers"
	depends on DRM && OF && (ARCH_HISI || COMPILE_TEST)
	select DRM_BRIDGE_CONNECTOR
	select DRM_DISPLAY_HELPER
	select DRM_GEM_DMA_HELPER
	select DRM_KMS_HELPER
	help
	  Choose this option to enable DRM/KMS support for the video display
	  processor found in the HiSilicon Hi3798CV200 and Hi3798MV310.
	  The driver exposes the primary graphics path through the atomic KMS
	  API and connects the display controller to an OF graph bridge.
	  MV310 accepts progressive RGB565/XRGB8888/ARGB8888 scanout up to
	  4096x2160 at 60 Hz, subject to a 594 MHz pixel-clock ceiling and the
	  HDMI bridge, sink and clock plan. Scaling and HDR are not supported.

	  If M is selected, the module will be called histb-vdp.
```

## drivers/media/platform/hisilicon/Kconfig
```kconfig
# SPDX-License-Identifier: GPL-2.0-only

comment "HiSilicon media platform drivers"

config VIDEO_HISTB_MEDIA_SMMU
	tristate
	depends on HAS_DMA
	depends on OF
	help
	  Shared CV200 media-SMMU page-table lifecycle used by the HiVXE
	  clients. This is an internal kernel component, not the legacy MMZ ABI.

config DVB_HISTB_DMX
	tristate "HiSilicon HiSTB transport stream demultiplexer"
	depends on DVB_PLATFORM_DRIVERS
	depends on DVB_CORE && I2C && OF && HAS_DMA
	depends on ARCH_HISI || COMPILE_TEST
	select DVB_MXL214 if MEDIA_SUBDRV_AUTOSELECT && GPIOLIB
	select DVB_HI3130 if MEDIA_SUBDRV_AUTOSELECT && GPIOLIB
	help
	  Support the transport stream input and descriptor DMA engine found in
	  HiSilicon HiSTB SoCs. The hardware DMA engine supplies complete MPEG
	  transport streams to the Linux DVB software demultiplexer.

	  To compile this driver as a module, choose M here. The module will be
	  called histb-dmx.

config VIDEO_HISTB_JPGE
	tristate "HiSilicon HiSTB JPEG encoder"
	depends on V4L_MEM2MEM_DRIVERS
	depends on ARCH_HISI || COMPILE_TEST
	depends on HAS_DMA && OF
	select V4L2_JPEG_HELPER
	select V4L2_MEM2MEM_DEV
	select VIDEOBUF2_DMA_CONTIG
	help
	  Support the stand-alone baseline JPEG encoder found in HiSilicon
	  Hi3798CV200 SoCs. The driver exposes a standard V4L2 memory-to-memory
	  encoder with semi-planar 4:2:0, 4:2:2 and 4:4:4 input, packed 4:2:2
	  input and JPEG output.

	  To compile this driver as a module, choose M here. The module will be
	  called histb-jpge.

config VIDEO_HISTB_JPGD
	tristate "HiSilicon HiSTB JPEG decoder"
	depends on V4L_MEM2MEM_DRIVERS
	depends on ARCH_HISI || COMPILE_TEST
	depends on HAS_DMA && OF
	select V4L2_JPEG_HELPER
	select V4L2_MEM2MEM_DEV
	select VIDEOBUF2_DMA_CONTIG
	help
	  Support the stand-alone baseline JPEG decoder found in HiSilicon
	  Hi3798CV200 and Hi3798MV310 SoCs. The driver exposes a V4L2
	  decoder with JPEG input and raw YUV output.

	  To compile this driver as a module, choose M here. The module will be
	  called histb-jpgd.

config VIDEO_HISTB_PNG
	tristate "HiSilicon Hi3798MV310 PNG decoder"
	depends on V4L_MEM2MEM_DRIVERS
	depends on ARCH_HISI || COMPILE_TEST
	depends on HAS_DMA && OF
	select CRC32
	select V4L2_MEM2MEM_DEV
	select VIDEOBUF2_DMA_CONTIG
	help
	  Support the PNG hardware decoder found in Hi3798MV310. Each OUTPUT
	  buffer contains one complete PNG file with fourcc 'PNG '; CAPTURE
	  provides RGBA32 pixels with a 16-byte-aligned stride. Both queue
	  dimensions must match the PNG IHDR before buffers are allocated.
	  Supports noninterlaced 8-bit grayscale, RGB, grayscale-alpha and RGBA.
	  Indexed, sub-8-bit, 16-bit, interlaced and animated PNGs are rejected.

	  To compile this driver as a module, choose M here. The module will be
	  called histb-png.

config VIDEO_HISTB_VDEC
	tristate "HiSilicon HiSTB video decoders"
	depends on V4L_MEM2MEM_DRIVERS
	depends on ARCH_HISI || COMPILE_TEST
	depends on HAS_DMA && OF && OF_RESERVED_MEM && CMA
	select V4L2_MEM2MEM_DEV
	select V4L2_VP9
	select VIDEOBUF2_DMA_CONTIG
	select VIDEO_HISTB_MEDIA_SMMU
	select VIDEOBUF2_VMALLOC
	select VIDEO_HISTB_VPSS
	help
	  Support the CV200 V4R3 and MV310 V5R6 VDH video decoders through
	  stateless V4L2 requests for H.264, HEVC, MPEG-2 and AVS/AVS+, plus
	  stateful MPEG-4 Part 2 and VC-1. CV200 also supports VP8 and VP9.
	  MV310 adds stateful AVS2 and MPEG-1 I/P/B, and two-view MVC through
	  H264_SLICE requests from a matching userspace implementation.
	  MPEG-1 full-pel currently has known chroma reconstruction errors.
	  Capture output is linear video; profiles and coding tools remain
	  limited by the implemented controls and bitstream validation.
	  RealVideo is not exposed.

	  To compile this driver as a module, choose M here. The module will be
	  called histb-vdec.

config VIDEO_HISTB_VENC
	tristate "HiSilicon HiSTB H.264 and HEVC encoders"
	depends on V4L_MEM2MEM_DRIVERS
	depends on ARCH_HISI || COMPILE_TEST
	depends on HAS_DMA && OF
	select V4L2_MEM2MEM_DEV
	select VIDEOBUF2_DMA_CONTIG
	select VIDEO_HISTB_MEDIA_SMMU
	help
	  Support the first-generation CV200 VEDU H.264 encoder and the
	  MV310 V500 H.264/HEVC encoder through V4L2 memory-to-memory queues.
	  Both support H.264 Baseline/Main/High, I/P frames, QP, bitrate,
	  frame-rate and GOP controls. MV310 additionally supports HEVC Main
	  with NV12M/NV21M input, single-slice frames and physical DMA32.
	  MV310 does not expose ROI, OSD, intra-refresh or multislice controls.
	  Main10 encoding, B frames and AVS encoding are not supported.

	  To compile this driver as a module, choose M here. The module will be
	  called histb-venc.

config VIDEO_HISTB_VPSS
	tristate "HiSilicon HiSTB video post-processing engines"
	depends on V4L_MEM2MEM_DRIVERS
	depends on ARCH_HISI || COMPILE_TEST
	depends on HAS_DMA && OF
	select VIDEO_HISTB_MEDIA_SMMU
	select V4L2_MEM2MEM_DEV
	select VIDEOBUF2_DMA_CONTIG
	help
	  Support the native CV200 and MV310 VPSS engines for converting
	  decoder tile surfaces into linear frames. Media drivers use the
	  internal conversion API. The separately registered memory-to-memory
	  node has its own format and processing limits.

	  To compile this driver as a module, choose M here. The module will be
	  called histb-vpss.
```

## drivers/phy/hisilicon/Kconfig
```kconfig
# SPDX-License-Identifier: GPL-2.0-only
#
# Phy drivers for Hisilicon platforms
#
config PHY_HI6220_USB
	tristate "hi6220 USB PHY support"
	depends on (ARCH_HISI && ARM64) || COMPILE_TEST
	depends on HAS_IOMEM
	select GENERIC_PHY
	select MFD_SYSCON
	help
	  Enable this to support the HISILICON HI6220 USB PHY.

	  To compile this driver as a module, choose M here.

config PHY_HI3660_USB
	tristate "hi3660 USB PHY support"
	depends on (ARCH_HISI && ARM64) || COMPILE_TEST
	select GENERIC_PHY
	select MFD_SYSCON
	help
	  Enable this to support the HISILICON HI3660 USB PHY.

	  To compile this driver as a module, choose M here.

config PHY_HI3670_USB
	tristate "hi3670 USB PHY support"
	depends on (ARCH_HISI && ARM64) || COMPILE_TEST
	select GENERIC_PHY
	select MFD_SYSCON
	help
	  Enable this to support the HISILICON HI3670 USB PHY.

	  To compile this driver as a module, choose M here.

config PHY_HI3670_PCIE
	tristate "hi3670 PCIe PHY support"
	depends on (ARCH_HISI && ARM64) || COMPILE_TEST
	select GENERIC_PHY
	select MFD_SYSCON
	help
	  Enable this to support the HiSilicon hi3670 PCIe PHY.

	  To compile this driver as a module, choose M here.

config PHY_HISTB_COMBPHY
	tristate "HiSilicon STB SoCs COMBPHY support"
	depends on (ARCH_HISI && ARM64) || (SOC_HI3798CV200 && ARM) || COMPILE_TEST
	select GENERIC_PHY
	select MFD_SYSCON
	help
	  Enable this to support the HISILICON STB SoCs COMBPHY.
	  If unsure, say N.

config PHY_HI3798MV310_USB2
	tristate "HiSilicon Hi3798MV310 USB2 PHY support"
	depends on ARCH_HISI || COMPILE_TEST
	depends on OF && HAS_IOMEM
	select GENERIC_PHY
	select MFD_SYSCON
	help
	  Enable the direct-MMIO three-port USB2 PHY on Hi3798MV310.
	  Its clocks and resets are sequenced together across all ports.

config PHY_HISI_INNO_USB2
	tristate "HiSilicon INNO USB2 PHY support"
	depends on ARCH_HISI || COMPILE_TEST
	select GENERIC_PHY
	select MFD_SYSCON
	help
	  Support for INNO USB2 PHY on HiSilicon SoCs. This Phy supports
	  USB 1.5Mb/s, USB 12Mb/s, USB 480Mb/s speeds. It supports one
	  USB host port to accept one USB device.

config PHY_HIX5HD2_SATA
	tristate "HIX5HD2 SATA PHY Driver"
	depends on ARCH_HIX5HD2 && OF && HAS_IOMEM
	select GENERIC_PHY
	select MFD_SYSCON
	help
	  Support for SATA PHY on Hisilicon hix5hd2 Soc.
```

## drivers/soc/hisilicon/Kconfig
```kconfig
# SPDX-License-Identifier: GPL-2.0-only

menu "Hisilicon SoC drivers"
	depends on ARCH_HISI || COMPILE_TEST

config KUNPENG_HCCS
	tristate "HCCS driver on Kunpeng SoC"
	depends on ACPI
	depends on PCC
	depends on ARM64 || COMPILE_TEST
	help
	  The Huawei Cache Coherence System (HCCS) is a multi-chip
	  interconnection bus protocol.
	  The performance of application may be affected if some HCCS
	  ports are not in full lane status, have a large number of CRC
	  errors and so on.

	  Say M here if you want to include support for querying the
	  health status and port information of HCCS on Kunpeng SoC.

config SOC_HI3798CV200
	bool "HiSilicon Hi3798CV200 SoC support"
	help
	  Enable SoC-specific integration for the HiSilicon Hi3798CV200.
	  This gates extensions to shared HiSilicon and ARM peripheral drivers
	  so builds for other SoCs retain their upstream behavior. Runtime
	  compatible data still selects each hardware-specific operation.

config HISTB_RTL8211F_LED
	bool "HiSTB RTL8211F link and activity LED wiring"
	depends on SOC_HI3798CV200 && OF && PHYLIB=y
	help
	  Configure RTL8211F LEDs as link and activity indicators when the
	  PHY node has realtek,led-link-activity. This requires the exact
	  RTL8211F PHY ID at MDIO address 3 and does not disable EEE power
	  saving or change the PHY driver or RGMII delays.

	  The fixup is registered before MDIO probing and reapplied by PHY
	  hardware initialization. PHY nodes without this property are ignored.

config HI3798MV310_IRQ_PROBE
	bool "Hi3798MV310 CPU0 timer IRQ bring-up probe"
	depends on ARCH_HISI_HISTB && ARM64 && OF && PROC_FS && DEBUG_KERNEL
	help
	  Build a RAM bring-up diagnostic for the BSP's hisilicon,hisp804
	  CPU0 timer. Requires a single online CPU. Root can arm one 100ms
	  hardware event or software-pend only the IRQ owned by this driver
	  through /proc/ec6110t_irq_probe. Does not replace clockevents or
	  the clocksource. Leave disabled for normal kernels.

endmenu
```

## sound/soc/hisilicon/Kconfig
```kconfig
# SPDX-License-Identifier: GPL-2.0-only
config SND_I2S_HI6210_I2S
	tristate "Hisilicon I2S controller"
	select SND_SOC_GENERIC_DMAENGINE_PCM
	help
	  Hisilicon I2S

config SND_SOC_HI3798CV200_AIAO
	tristate "HiSilicon Hi3798CV200/Hi3798MV310 AIAO controller"
	depends on ARCH_HISI || COMPILE_TEST
	help
	  Say Y or M to enable the standard ASoC playback interface for the
	  Hi3798CV200 and Hi3798MV310 AIAO controllers. The driver uses native
	  circular DMA buffers with standard ASoC DAI and PCM interfaces.
	  DAI 0 preserves the board's analog/external I2S routing; DAI 1 uses
	  the SoC's internal HDMI port. Both expose stereo 16-bit or 24-bit
	  PCM (24 significant MSBs in S32_LE DMA words).
```
